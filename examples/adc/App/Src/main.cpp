/** This is a really basic example of using digital pins on the 
SPEAR SPEEDY such as polling input **/


// This is for showing the dac with the adc, hookup pin A0 and pin A4 of the speedy together to see the effect
// For 2 input ADC sampling, make sure that #define ADC_SINGLEINPUT is commented out connect A1 to A0 as well

#include "ch.h"
#include "hal.h"
#include "chprintf.h"

#define ADC_SINGLEINPUT 

// Sine wave lookup table for DAC usage
dacsample_t sineWave[] = {
0x800,0x80d,0x819,0x826,0x832,0x83f,0x84b,0x858,
0x865,0x871,0x87e,0x88a,0x897,0x8a3,0x8b0,0x8bc,
0x8c9,0x8d5,0x8e2,0x8ee,0x8fb,0x907,0x914,0x920,
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0x7a8,0x7b5,0x7c1,0x7ce,0x7da,0x7e7,0x7f3,0x800,
};
#ifdef ADC_SINGLEINPUT
static const ADCConversionGroup adcCfg = {
  .circular     = false,
  .num_channels = 1,
  .end_cb       = NULL,
  .error_cb     = NULL,
  .cfgr         = ADC_CFGR_CONT,
  .tr1          = ADC_TR_DISABLED,
  .tr2          = ADC_TR_DISABLED,
  .tr3          = ADC_TR_DISABLED,
  .awd2cr       = 0U,
  .awd3cr       = 0U,
  .smpr         = {
    ADC_SMPR1_SMP_AN1(ADC_SMPR_SMP_19P5),
    0
  },
  .sqr          = {
    ADC_SQR1_SQ1_N(ADC_CHANNEL_IN1),
    0,
    0,
    0
  }
};
#else
static const ADCConversionGroup adcCfg = {
  .circular     = false,
  .num_channels = 2,
  .end_cb       = NULL,
  .error_cb     = NULL,
  .cfgr         = ADC_CFGR_CONT,
  .tr1          = ADC_TR_DISABLED,
  .tr2          = ADC_TR_DISABLED,
  .tr3          = ADC_TR_DISABLED,
  .awd2cr       = 0U,
  .awd3cr       = 0U,
  .smpr         = {
    ADC_SMPR1_SMP_AN0(ADC_SMPR_SMP_19P5) | // Configure ADC1 Channel 0 to have 32 cycles conversion time
	 ADC_SMPR1_SMP_AN1(ADC_SMPR_SMP_19P5),
    0
  },
  .sqr          = {
    ADC_SQR1_SQ1_N(ADC_CHANNEL_IN0) | ADC_SQR1_SQ1_N(ADC_CHANNEL_IN1), // In this config, our buffer will be like [IN0, IN1, IN0,..]
    0,
    0,
    0
  }
};
#endif


DACConversionGroup dacCfg = {
  .num_channels = 1,
  .end_cb = NULL,
  .error_cb = NULL,
  .trigger = DAC_TRG(0)
};

void readADC(void)
{
	adcsample_t buffer[2];
	msg_t status = adcConvert(&ADCD1, &adcCfg, buffer, 2);
	if(status == MSG_OK) {
		#ifdef ADC_SINGLEINPUT
		chprintf((BaseSequentialStream*)&SD2, "ADC 0 is %d \r\n", buffer[0]);
		#else
		chprintf((BaseSequentialStream*)&SD2, "ADC 0 is %d | ADC 1 is %d |", buffer[0], buffer[1]);
		#endif
	}
}
static THD_WORKING_AREA(adcReadWorkingArea, 1024);
static THD_FUNCTION(adcTestFn, arg) {
  (void)arg;
  while (1)
  {
    readADC();
    chThdSleepMilliseconds(1);
  }
}
const DACConfig dac1cfg1 = {.init = 4047U, .datamode = DAC_DHRM_12BIT_RIGHT};
static THD_WORKING_AREA(dacTestWorkingArea, 1024);
static THD_FUNCTION(dacTestFn, arg) {
  (void)arg;
  unsigned int i = 0;
	while(1) {
    // dac
		dacPutChannelX(&DACD1, 0, sineWave[i]);
    i++;
    if(i >= sizeof(sineWave)/sizeof(dacsample_t)) {
      i = 0;
    }
    chThdSleepMilliseconds(1);
  }

}


int main(void)
{
	// These are mandatory for the project
	chSysInit();
	halInit();
	sdStart(&SD2, NULL);
	// Start DAC1 for DAC Peripheral
	// Configure A4 as Input Analog Mode
	palSetPadMode(GPIOA, GPIOA_PIN4, PAL_MODE_INPUT_ANALOG);
	// Configure A0 as Input Analog Mode
	palSetPadMode(GPIOA, GPIOA_PIN0, PAL_MODE_INPUT_ANALOG);
	// Configure A1 as Input Analog Mode
	palSetPadMode(GPIOA, GPIOA_PIN1, PAL_MODE_INPUT_ANALOG);
  adcStart(&ADCD1, NULL);
	dacStart(&DACD1, &dac1cfg1);
  (void) chThdCreateStatic(adcReadWorkingArea, sizeof(adcReadWorkingArea),
                          NORMALPRIO, adcTestFn, NULL);
  (void) chThdCreateStatic(dacTestWorkingArea, sizeof(dacTestWorkingArea),
                        NORMALPRIO + 1, dacTestFn, NULL);
	while(1) {
		chThdSleepMilliseconds(1);
	}
}


